## boards/shields/Retros_Ideal_Keyboard/Kconfig.defconfig
```kconfig
# Copyright (c) 2020 The ZMK Contributors
# SPDX-License-Identifier: MIT

if SHIELD_RETROS_IDEAL_KEYBOARD_LEFT

config ZMK_KEYBOARD_NAME
    default "Retros_Ideal_Keyboard"

config ZMK_SPLIT_ROLE_CENTRAL
    default y

endif

if SHIELD_RETROS_IDEAL_KEYBOARD || SHIELD_RETROS_IDEAL_KEYBOARD

config ZMK_SPLIT
    default y

endif
```

## boards/shields/Retros_Ideal_Keyboard/Kconfig.shield
```kconfig
# Copyright (c) 2020 The ZMK Contributors
# SPDX-License-Identifier: MIT

config SHIELD_RETROS_IDEAL_KEYBOARD_LEFT
    def_bool $(shields_list_contains,retros_ideal_keyboard_left)

config SHIELD_RETROS_IDEAL_KEYBOARD_RIGHT
    def_bool $(shields_list_contains,retros_ideal_keyboard_right)
```

## boards/shields/Retros_Keyb/Kconfig.defconfig
```kconfig
# Copyright (c) 2020 The ZMK Contributors
# SPDX-License-Identifier: MIT

if SHIELD_RETROS_KEYB_L

config ZMK_KEYBOARD_NAME
    default "Retros_Keyb"

config ZMK_SPLIT_ROLE_CENTRAL
    default y

endif

if SHIELD_RETROS_KEYB_L || SHIELD_RETROS_KEYB_R

config ZMK_SPLIT
    default y

endif
```

## boards/shields/Retros_Keyb/Kconfig.shield
```kconfig
# Copyright (c) 2020 The ZMK Contributors
# SPDX-License-Identifier: MIT

config SHIELD_RETROS_KEYB_L
    def_bool $(shields_list_contains,retros_keyb_l)

config SHIELD_RETROS_KEYB_R
    def_bool $(shields_list_contains,retros_keyb_r)
```
